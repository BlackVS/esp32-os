## components/Boards/Kconfig.projbuild
```kconfig
menu "ESP32 target board"

choice ESP32_BOARD_MODEL
    prompt "ESP32 board model"
    default ESP32_BOARD_NNC2019
    help
        Select ESP32 board model which will be used with this project.

config ESP32_BOARD_NNC2019
    bool "NNC2019"
config ESP32_BOARD_TTGO
    bool "TTGO"
config ESP32_BOARD_M5STICKC
    bool "M5STICKC"

endchoice


endmenu
```

## sdkconfig.defaults.nnc2019
```kconfig
CONFIG_ESP32_BOARD_NNC2019=y
CONFIG_ESP32_DEFAULT_CPU_FREQ_240=y
CONFIG_ESPTOOLPY_FLASHSIZE_4MB=y

CONFIG_MPU9250=y
CONFIG_MPU_I2C=y

CONFIG_OTA_ALLOW_HTTP=y

CONFIG_PARTITION_TABLE_CUSTOM=y
CONFIG_PARTITION_TABLE_CUSTOM_FILENAME="partitions.csv"
CONFIG_PARTITION_TABLE_FILENAME="partitions.csv"
CONFIG_PARTITION_TABLE_OFFSET=0x8000

CONFIG_ESP_MAIN_TASK_STACK_SIZE=7168
CONFIG_ESP_IPC_TASK_STACK_SIZE=2048

CONFIG_COMPILER_OPTIMIZATION_LEVEL_RELEASE=y
CONFIG_ESP32_DEBUG_STUBS_ENABLE=y

CONFIG_FATFS_LFN_HEAP=y
CONFIG_FATFS_MAX_LFN=31
CONFIG_FATFS_API_ENCODING_ANSI_OEM=y

CONFIG_LWIP_TCP_MSS=1436

CONFIG_MBEDTLS_HARDWARE_MPI=y

CONFIG_WL_SECTOR_SIZE_512=y
CONFIG_WL_SECTOR_MODE_SAFE=y
```
